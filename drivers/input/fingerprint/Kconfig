## drivers/input/fingerprint/Kconfig
```kconfig
#
# Fingerprint driver configuration
#

if MACH_ASUS_SDM660

menuconfig INPUT_FINGERPRINT
	bool "Fingerprint"
	help
	  Say Y here, and a list of supported fingerprint will be displayed.
	  This option doesn't affect the kernel.

	  If unsure, say Y.

if INPUT_FINGERPRINT

if MACH_ASUS_X01BD

config CDFINGER_FP
	bool "Fingerprint cdfinger"
	help
	  Say Y here if you use common fp.
	  If unsure, say N.

config FOCALTECH_FP
	bool "Fingerprint focaltech"
	help
	  Say Y here if you use focaltech fp.
	  If unsure, say N.

endif

if MACH_ASUS_X00TD

config COMMON_FP_X00TD
    bool "Fingerprint common"
	default n
	help
		Say Y here if you use common fp.
		If unsure, say N.

config CDFINGER_FP_X00TD
    bool "Fingerprint cdfinger"
	help
		Say Y here if you use cdfinger fp.
		If unsure, say N.

config GOODIX_FP_X00TD
    bool "Fingerprint goodix"
	select COMMON_FP
	help
		Say Y here if you use goodix fp.
		If unsure, say N.

endif

endif
endif
```
